## CMakeLists.txt
```
# SPDX-License-Identifier: Apache-2.0

cmake_minimum_required(VERSION 3.20.0)

find_package(Zephyr REQUIRED HINTS $ENV{ZEPHYR_BASE})
project(lvgl_sample)

FILE(GLOB_RECURSE app_sources src/*.c)
target_sources(app PRIVATE ${app_sources})

target_include_directories(app PRIVATE src)
```

## Kconfig
```
# SPDX-License-Identifier: Apache-2.0

# Our fake WiFi driver (src/net/wifi_fake_drv.c) is registered via
# ETH_NET_DEVICE_INIT, which requires struct net_wifi_mgmt_offload.wifi_iface
# to be shaped as struct ethernet_api (only the case when this is selected).
config WIFI_USE_NATIVE_NETWORKING
	default y if WIFI

source "Kconfig.zephyr"
```

## west.yml
```
# Wi-Fi manifest: jukkar's fork, which carries the native_sim Wi-Fi driver
# (PR #110681) that upstream does not have yet. hostap is the supplicant.
#
# Select with: ./scripts/switch-zephyr.sh wifi   (see west-base.yml for the other)
manifest:
  remotes:
    - name: zephyrproject-rtos
      url-base: https://github.com/zephyrproject-rtos

  projects:
    - name: zephyr
      url: https://github.com/jukkar/zephyr
      revision: devel/wifi-driver-for-native_sim
      import:
        name-allowlist: [lvgl, mbedtls, tf-psa-crypto, hostap, picolibc]


  self:
    path: lvgl-demo
```

## prj.conf
```kconfig
CONFIG_MAIN_STACK_SIZE=6144
CONFIG_LOG=y

CONFIG_LVGL=y
CONFIG_LV_Z_MEM_POOL_SIZE=16384

# src/diag/heap-monitor.c: max_allocated_bytes / free_bytes are only tracked
# when the heap gathers runtime stats. ARRAY_SIZE makes every sys_heap register
# itself from sys_heap_init(), which is the only way to reach the kernel system
# heap and the libc arena - neither exposes its sys_heap. The monitor warns if
# this is too small, since the overflow is otherwise silent.
CONFIG_SYS_HEAP_RUNTIME_STATS=y
CONFIG_SYS_HEAP_ARRAY_SIZE=8

CONFIG_DISPLAY=y
CONFIG_INPUT=y

CONFIG_LV_FONT_MONTSERRAT_14=y

# No networking here on purpose: this is the base build, and it must compile
# against plain upstream Zephyr. Wi-Fi Kconfigs live in overlays/wifi.conf and
# are opted into alongside one of the overlays - see readme.md.
```

## boards/native_sim.conf
```kconfig
# Copyright 2023 Fabian Blatz <fabianblatz@gmail.com>
# SPDX-License-Identifier: Apache-2.0

CONFIG_LV_COLOR_DEPTH_32=y
CONFIG_LV_Z_MEM_POOL_SIZE=81920

# Step 3: headroom for wpa_supplicant + nl80211 driver
CONFIG_HEAP_MEM_POOL_SIZE=65535

CONFIG_ETH_NATIVE_TAP=n

# The Wi-Fi interface only comes up after a connect, so disable net_config's
# "need address" waits: otherwise net_config blocks for up to
# CONFIG_NET_CONFIG_INIT_TIMEOUT (30s) at boot and logs a spurious failure.
CONFIG_NET_CONFIG_SETTINGS=y
CONFIG_NET_CONFIG_NEED_IPV4=n
CONFIG_NET_CONFIG_NEED_IPV6=n
```

## boards/native_sim.overlay
```dts
/*
 * Copyright (c) 2023, Fabian Blatz <fabianblatz@gmail.com>
 *
 * SPDX-License-Identifier: Apache-2.0
 */

/* Base build: display only. The Wi-Fi node lives in overlays/dev-iface.overlay
 * or overlays/real-card.overlay, neither of which builds on upstream Zephyr.
 */

&sdl_dc {
	compatible = "zephyr,sdl-dc";
	height = <900>;
	width = <480>;
};
```

## src/main.c
```c
/*
 * SPDX-License-Identifier: Apache-2.0
 */

#include <zephyr/kernel.h>
#include <zephyr/drivers/display.h>
#include <lvgl.h>
#include <lvgl_zephyr.h>

#include "app_events.h"
#include "ui/ui.h"
#include "net/wifi-sta.h"
#include "diag/heap-monitor.h"

#define LOG_LEVEL CONFIG_LOG_DEFAULT_LEVEL
#include <zephyr/logging/log.h>
LOG_MODULE_REGISTER(app);

#define UI_THREAD_STACK_SIZE 4096
#define UI_THREAD_PRIORITY   5

#define EVENT_PRODUCER_STACK_SIZE 1024
#define EVENT_PRODUCER_PRIORITY   7

K_MSGQ_DEFINE(event_queue, sizeof(struct app_event), 4, 4);

void app_event_post(enum app_event_id id)
{
	struct app_event evt = { .id = id };

	k_msgq_put(&event_queue, &evt, K_NO_WAIT);
}

static struct k_timer tick_timer;

static void tick_timer_expiry(struct k_timer *timer)
{
	ARG_UNUSED(timer);

	app_event_post(APP_EVENT_TICK);
}

static void event_producer_thread(void *p1, void *p2, void *p3)
{
	ARG_UNUSED(p1);
	ARG_UNUSED(p2);
	ARG_UNUSED(p3);

	k_timer_init(&tick_timer, tick_timer_expiry, NULL);
	k_timer_start(&tick_timer, K_SECONDS(1), K_SECONDS(1));
}

static void ui_thread(void *p1, void *p2, void *p3)
{
	ARG_UNUSED(p1);
	ARG_UNUSED(p2);
	ARG_UNUSED(p3);

	const struct device *display_dev;
	int ret;

	display_dev = DEVICE_DT_GET(DT_CHOSEN(zephyr_display));
	if (!device_is_ready(display_dev)) {
		LOG_ERR("Device not ready, aborting test");
		return;
	}

	lvgl_lock();
	ui_init();
	lv_timer_handler();
	lvgl_unlock();

	ret = display_blanking_off(display_dev);
	if (ret < 0 && ret != -ENOSYS) {
		LOG_ERR("Failed to turn blanking off (error %d)", ret);
		return;
	}

	while (1) {
		struct app_event evt;
		uint32_t sleep_ms;

		lvgl_lock();
		if (k_msgq_get(&event_queue, &evt, K_NO_WAIT) == 0) {
			switch (evt.id)
			{
			case APP_EVENT_TICK:
				heap_monitor_on_tick();
				break;
			case APP_EVENT_GOTO_HOME:
				ui_handle_event(&evt);
				break;
			case APP_EVENT_GOTO_WIFI_PROVISIONING:
				ui_handle_event(&evt);
				break;
			case APP_EVENT_WIFI_SCAN_REQUEST:
				wifi_sta_scan();
				break;
			case APP_EVENT_WIFI_CONNECT_REQUEST:
				wifi_sta_connect();
				break;
			case APP_EVENT_WIFI_SCAN_DONE:
				ui_handle_event(&evt);
				break;

			default:
				break;
			}
		}
		sleep_ms = lv_timer_handler();
		lvgl_unlock();

		k_msleep(MIN(sleep_ms, INT32_MAX));
	}
}

K_THREAD_DEFINE(ui_tid, UI_THREAD_STACK_SIZE, ui_thread, NULL, NULL, NULL,
		 UI_THREAD_PRIORITY, 0, 0);

K_THREAD_DEFINE(event_producer_tid, EVENT_PRODUCER_STACK_SIZE, event_producer_thread,
		 NULL, NULL, NULL, EVENT_PRODUCER_PRIORITY, 0, 0);

int main(void)
{
	heap_monitor_init();
	wifi_sta_init();

	return 0;
}
```

## src/app_events.h
```c
/*
 * SPDX-License-Identifier: Apache-2.0
 */

#ifndef APP_EVENTS_H_
#define APP_EVENTS_H_

enum app_event_id {
	APP_EVENT_TICK,
	APP_EVENT_GOTO_HOME,
	APP_EVENT_GOTO_WIFI_PROVISIONING,
	APP_EVENT_WIFI_SCAN_RESULT,
	APP_EVENT_WIFI_SCAN_DONE,
	APP_EVENT_WIFI_SCAN_REQUEST,
	APP_EVENT_WIFI_CONNECT_REQUEST
};

struct app_event {
	enum app_event_id id;
};

void app_event_post(enum app_event_id id);

#endif /* APP_EVENTS_H_ */
```
